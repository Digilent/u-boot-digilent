## board/digilent/Kconfig
```kconfig
# SPDX-License-Identifier: GPL-2.0
#
# Copyright (c) 2023, Ionel Bădișor <ionel.badisor@digilent.ro>


if ARCH_ZYNQ || ARCH_ZYNQMP

config ZYNQ_GEM_MAC_FROM_QSPI
	bool "Read MAC address form QSPI"
	depends on DM_SPI
	help
		Enable to read MAC address from mac

	if ZYNQ_GEM_MAC_FROM_QSPI

		config ZYNQ_GEM_MAC_IN_OTP
			bool "Read MAC address form QSPI OTP section"
			help
				Specify OTP section of QSPI for reading
				This requires custom read operation code to be set
				according to used IC.

		if ZYNQ_GEM_MAC_IN_OTP
		
			config QSPI_IS_SM
				bool "Read MAC address form Spansion Micron QSPI flash "
				help
					QSPI IC is Spanssion
				
			config QSPI_IS_WB
				bool "Read MAC address form Winbond QSPI flash"
				depends on !QSPI_IS_SM
				help
					QSPI IC is Winbond

		endif

	config ZYNQ_GEM_MAC_QSPI_OFFSET
		hex "Ethernet mac offset in QSPI"
		depends on ZYNQ_GEM_MAC_FROM_QSPI || ZYNQ_GEM_MAC_IN_OTP || QSPI_IS_SM || QSPI_IS_WB
		default 0x20 if ZYNQ_GEM_MAC_IN_OTP && QSPI_IS_SM && !QSPI_IS_WB
		default 0x1000 if ZYNQ_GEM_MAC_IN_OTP && !QSPI_IS_SM && QSPI_IS_WB
		default 0x0 if ZYNQ_GEM_MAC_FROM_QSPI && !ZYNQ_GEM_MAC_IN_OTP
		help
			Set MAC offset for QSPI (regular or OTP address space)

	endif

endif
```
